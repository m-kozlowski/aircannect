    EDF_STR_SIGNAL(Custom, nullptr, "Date", "", "0.00", "24836.00", "0", "24836",
                   0, 24836, 1)
    EDF_STR_SIGNAL(Custom, nullptr, "MaskOn", "MINUTES", "0.00", "1440.00", "0", "1440",
                   0, 1440, 20)
    EDF_STR_SIGNAL(Custom, nullptr, "MaskOff", "MINUTES", "0.00", "1440.00", "0", "1440",
                   0, 1440, 20)
    EDF_STR_SIGNAL(Custom, nullptr, "MaskEvents", "", "0.00", "255.00", "0", "255",
                   0, 255, 1)
    EDF_STR_SIGNAL(Derived, "PPD", "Duration", "min.", "0.00", "1440.00", "0", "1440",
                   0, 1440, 1)
    EDF_STR_SIGNAL(SettingGet, "MOP", "Mode", "", "0", "16", "0", "16",
                   0, 16, 1)
    EDF_STR_SIGNAL(SettingGet, "STP", "S.C.StartPress", "cmH2O", "4.00", "20.00", "200", "1000",
                   200, 1000, 1)
    EDF_STR_SIGNAL(SettingGet, "IPC", "S.C.Press", "cmH2O", "4.00", "20.00", "200", "1000",
                   200, 1000, 1)
    EDF_STR_SIGNAL(SettingGet, "STU", "S.A.StartPress", "cmH2O", "4.00", "20.00", "200", "1000",
                   200, 1000, 1)
    EDF_STR_SIGNAL(SettingGet, "MPA", "S.A.MaxPress", "cmH2O", "4.00", "20.00", "200", "1000",
                   200, 1000, 1)
    EDF_STR_SIGNAL(SettingGet, "MPI", "S.A.MinPress", "cmH2O", "4.00", "20.00", "200", "1000",
                   200, 1000, 1)
    EDF_STR_SIGNAL(SettingGet, "HSP", "S.AFH.StartPress", "cmH2O", "4.00", "20.00", "200", "1000",
                   200, 1000, 1)
    EDF_STR_SIGNAL(SettingGet, "HMA", "S.AFH.MaxPress", "cmH2O", "4.00", "20.00", "200", "1000",
                   200, 1000, 1)
    EDF_STR_SIGNAL(SettingGet, "HMI", "S.AFH.MinPress", "cmH2O", "4.00", "20.00", "200", "1000",
                   200, 1000, 1)
    EDF_STR_SIGNAL(SettingGet, "XE0", "S.VA.StartPress", "cmH2O", "4.00", "25.00", "200", "1250",
                   200, 1250, 1)
    EDF_STR_SIGNAL(SettingGet, "XE1", "S.VA.MaxIPAP", "cmH2O", "4.00", "25.00", "200", "1250",
                   200, 1250, 1)
    EDF_STR_SIGNAL(SettingGet, "XE2", "S.VA.MinEPAP", "cmH2O", "4.00", "25.00", "200", "1250",
                   200, 1250, 1)
    EDF_STR_SIGNAL(SettingGet, "XE3", "S.VA.PS", "cmH2O", "0.00", "10.00", "0", "500",
                   0, 500, 1)
    EDF_STR_SIGNAL(SettingGet, "XE4", "S.VA.TiMax", "seconds", "0.30", "4.00", "15", "200",
                   15, 200, 1)
    EDF_STR_SIGNAL(SettingGet, "XE5", "S.VA.TiMin", "seconds", "0.10", "4.00", "5", "200",
                   5, 200, 1)
    EDF_STR_SIGNAL(SettingGet, "XE6", "S.VA.Trigger", "", "0", "16", "0", "16",
                   0, 16, 1)
    EDF_STR_SIGNAL(SettingGet, "XE7", "S.VA.Cycle", "", "0", "16", "0", "16",
                   0, 16, 1)
    EDF_STR_SIGNAL(SettingGet, "ZZ3", "S.S.StartPress", "cmH2O", "2.00", "25.00", "100", "1250",
                   100, 1250, 1)
    EDF_STR_SIGNAL(SettingGet, "ZZ1", "S.S.IPAP", "cmH2O", "4.00", "25.00", "200", "1250",
                   200, 1250, 1)
    EDF_STR_SIGNAL(SettingGet, "ZZ2", "S.S.EPAP", "cmH2O", "2.00", "25.00", "100", "1250",
                   100, 1250, 1)
    EDF_STR_SIGNAL(SettingGet, "ZZ4", "S.S.EasyBreathe", "", "0", "16", "0", "16",
                   0, 16, 1)
    EDF_STR_SIGNAL(SettingGet, "ZZ5", "S.S.RespRateEn", "", "0", "16", "0", "16",
                   0, 16, 1)
    EDF_STR_SIGNAL(SettingGet, "ZZ7", "S.S.TiMax", "seconds", "0.30", "4.00", "15", "200",
                   15, 200, 1)
    EDF_STR_SIGNAL(SettingGet, "ZZ8", "S.S.TiMin", "seconds", "0.10", "4.00", "5", "200",
                   5, 200, 1)
    EDF_STR_SIGNAL(SettingGet, "ZZ9", "S.S.RiseEnable", "", "0", "16", "0", "16",
                   0, 16, 1)
    EDF_STR_SIGNAL(SettingGet, "Z10", "S.S.RiseTime", "msec", "150.00", "900.00", "150", "900",
                   150, 900, 1)
    EDF_STR_SIGNAL(SettingGet, "Z11", "S.S.Trigger", "", "0", "16", "0", "16",
                   0, 16, 1)
    EDF_STR_SIGNAL(SettingGet, "Z12", "S.S.Cycle", "", "0", "16", "0", "16",
                   0, 16, 1)
    EDF_STR_SIGNAL(SettingGet, "XA3", "S.ST.StartPress", "cmH2O", "2.00", "25.00", "100", "1250",
                   100, 1250, 1)
    EDF_STR_SIGNAL(SettingGet, "XA1", "S.ST.IPAP", "cmH2O", "4.00", "25.00", "200", "1250",
                   200, 1250, 1)
    EDF_STR_SIGNAL(SettingGet, "XA2", "S.ST.EPAP", "cmH2O", "2.00", "25.00", "100", "1250",
                   100, 1250, 1)
    EDF_STR_SIGNAL(SettingGet, "XA6", "S.ST.RespRate", "bpm", "0.00", "50.00", "0", "250",
                   0, 250, 1)
    EDF_STR_SIGNAL(SettingGet, "XA7", "S.ST.TiMax", "seconds", "0.30", "4.00", "15", "200",
                   15, 200, 1)
    EDF_STR_SIGNAL(SettingGet, "XA8", "S.ST.TiMin", "seconds", "0.10", "4.00", "5", "200",
                   5, 200, 1)
    EDF_STR_SIGNAL(SettingGet, "XA9", "S.ST.RiseEnable", "", "0", "16", "0", "16",
                   0, 16, 1)
    EDF_STR_SIGNAL(SettingGet, "XAA", "S.ST.RiseTime", "msec", "150.00", "900.00", "150", "900",
                   150, 900, 1)
    EDF_STR_SIGNAL(SettingGet, "ZU1", "S.ST.Trigger", "", "0", "16", "0", "16",
                   0, 16, 1)
    EDF_STR_SIGNAL(SettingGet, "XAB", "S.ST.Cycle", "", "0", "16", "0", "16",
                   0, 16, 1)
    EDF_STR_SIGNAL(SettingGet, "XB0", "S.T.StartPress", "cmH2O", "2.00", "25.00", "100", "1250",
                   100, 1250, 1)
    EDF_STR_SIGNAL(SettingGet, "XB1", "S.T.IPAP", "cmH2O", "4.00", "25.00", "200", "1250",
                   200, 1250, 1)
    EDF_STR_SIGNAL(SettingGet, "XB2", "S.T.EPAP", "cmH2O", "2.00", "25.00", "100", "1250",
                   100, 1250, 1)
    EDF_STR_SIGNAL(SettingGet, "XB4", "S.T.RespRate", "bpm", "5.00", "50.00", "25", "250",
                   25, 250, 1)
    EDF_STR_SIGNAL(SettingGet, "XB5", "S.T.Ti", "seconds", "0.30", "4.00", "15", "200",
                   15, 200, 1)
    EDF_STR_SIGNAL(SettingGet, "XB6", "S.T.RiseEnable", "", "0", "16", "0", "16",
                   0, 16, 1)
    EDF_STR_SIGNAL(SettingGet, "XB7", "S.T.RiseTime", "msec", "150.00", "900.00", "150", "900",
                   150, 900, 1)
    EDF_STR_SIGNAL(SettingGet, "XC0", "S.AV.StartPress", "cmH2O", "4.00", "15.00", "200", "750",
                   200, 750, 1)
    EDF_STR_SIGNAL(SettingGet, "XC1", "S.AV.EPAP", "cmH2O", "4.00", "15.00", "200", "750",
                   200, 750, 1)
    EDF_STR_SIGNAL(SettingGet, "XC2", "S.AV.MaxPS", "cmH2O", "0.00", "20.00", "0", "1000",
                   0, 1000, 1)
    EDF_STR_SIGNAL(SettingGet, "XC3", "S.AV.MinPS", "cmH2O", "0.00", "6.00", "0", "300",
                   0, 300, 1)
    EDF_STR_SIGNAL(SettingGet, "XD0", "S.AA.StartPress", "cmH2O", "4.00", "15.00", "200", "750",
                   200, 750, 1)
    EDF_STR_SIGNAL(SettingGet, "XD1", "S.AA.MaxEPAP", "cmH2O", "4.00", "15.00", "200", "750",
                   200, 750, 1)
    EDF_STR_SIGNAL(SettingGet, "XD2", "S.AA.MinEPAP", "cmH2O", "4.00", "15.00", "200", "750",
                   200, 750, 1)
    EDF_STR_SIGNAL(SettingGet, "XD3", "S.AA.MaxPS", "cmH2O", "0.00", "20.00", "0", "1000",
                   0, 1000, 1)
    EDF_STR_SIGNAL(SettingGet, "XD4", "S.AA.MinPS", "cmH2O", "0.00", "6.00", "0", "300",
                   0, 300, 1)
    EDF_STR_SIGNAL(SettingGet, "AFC", "S.AS.Comfort", "", "0", "16", "0", "16",
                   0, 16, 1)
    EDF_STR_SIGNAL(SettingGet, "RMA", "S.RampEnable", "", "0", "16", "0", "16",
                   0, 16, 1)
    EDF_STR_SIGNAL(SettingGet, "RMT", "S.RampTime", "min.", "5.00", "45.00", "5", "45",
                   5, 45, 1)
    EDF_STR_SIGNAL(SettingGet, "EPA", "S.EPR.ClinEnable", "", "0", "16", "0", "16",
                   0, 16, 1)
    EDF_STR_SIGNAL(SettingGet, "EPX", "S.EPR.EPREnable", "", "0", "16", "0", "16",
                   0, 16, 1)
    EDF_STR_SIGNAL(SettingGet, "EPR", "S.EPR.Level", "cmH2O", "1.00", "3.00", "50", "150",
                   50, 150, 1)
    EDF_STR_SIGNAL(SettingGet, "EPT", "S.EPR.EPRType", "", "0", "16", "0", "16",
                   0, 16, 1)
    EDF_STR_SIGNAL(SettingGet, "SST", "S.SmartStart", "", "0", "16", "0", "16",
                   0, 16, 1)
    EDF_STR_SIGNAL(SettingGet, "ACC", "S.PtAccess", "", "0", "16", "0", "16",
                   0, 16, 1)
    EDF_STR_SIGNAL(SettingGet, "ABF", "S.ABFilter", "", "0", "16", "0", "16",
                   0, 16, 1)
    EDF_STR_SIGNAL(SettingGet, "MSK", "S.Mask", "", "0", "16", "0", "16",
                   0, 16, 1)
    EDF_STR_SIGNAL(SettingGet, "TBT", "S.Tube", "", "0", "16", "0", "16",
                   0, 16, 1)
    EDF_STR_SIGNAL(SettingGet, "CCO", "S.ClimateControl", "", "0", "16", "0", "16",
                   0, 16, 1)
    EDF_STR_SIGNAL(SettingGet, "HMX", "S.HumEnable", "", "0", "16", "0", "16",
                   0, 16, 1)
    EDF_STR_SIGNAL(SettingGet, "HMS", "S.HumLevel", "", "1.00", "8.00", "1", "8",
                   1, 8, 1)
    EDF_STR_SIGNAL(SettingGet, "HTX", "S.TempEnable", "", "0", "16", "0", "16",
                   0, 16, 1)
    EDF_STR_SIGNAL(SettingGet, "HTS", "S.Temp", "Celsius", "15.60", "30.00", "156", "300",
                   156, 300, 1)
    EDF_STR_SIGNAL(Summary, "ZHT", "HeatedTube", "", "0", "16", "0", "16",
                   0, 16, 1)
    EDF_STR_SIGNAL(Summary, "HUC", "Humidifier", "", "0", "16", "0", "16",
                   0, 16, 1)
    EDF_STR_SIGNAL(Summary, "BP9", "BlowPress.95", "cmH2O", "-10.00", "45.00", "-500", "2250",
                   -500, 2250, 1)
    EDF_STR_SIGNAL(Summary, "BP5", "BlowPress.5", "cmH2O", "-10.00", "45.00", "-500", "2250",
                   -500, 2250, 1)
    EDF_STR_SIGNAL(Summary, "R95", "Flow.95", "L/s", "-2.00", "3.00", "-1000", "1500",
                   -1000, 1500, 1)
    EDF_STR_SIGNAL(Summary, "RFM", "Flow.5", "L/s", "-2.00", "3.00", "-1000", "1500",
                   -1000, 1500, 1)
    EDF_STR_SIGNAL(Summary, "BFM", "BlowFlow.50", "L/s", "-4.00", "4.00", "-2000", "2000",
                   -2000, 2000, 1)
    EDF_STR_SIGNAL(Summary, "AUM", "AmbHumidity.50", "mg/L", "0.00", "100.00", "0", "1000",
                   0, 1000, 1)
    EDF_STR_SIGNAL(Summary, "HHE", "HumTemp.50", "Celsius", "0.00", "100.00", "0", "1000",
                   0, 1000, 1)
    EDF_STR_SIGNAL(Summary, "HTE", "HTubeTemp.50", "Celsius", "0.00", "40.00", "0", "400",
                   0, 400, 1)
    EDF_STR_SIGNAL(Summary, "AHM", "HTubePow.50", "%", "0.00", "100.00", "0", "1000",
                   0, 1000, 1)
    EDF_STR_SIGNAL(Summary, "APM", "HumPow.50", "%", "0.00", "100.00", "0", "1000",
                   0, 1000, 1)
    EDF_STR_SIGNAL(Summary, "SOM", "SpO2.50", "%", "0.00", "100.00", "0", "100",
                   0, 100, 1)
    EDF_STR_SIGNAL(Summary, "SO9", "SpO2.95", "%", "0.00", "100.00", "0", "100",
                   0, 100, 1)
    EDF_STR_SIGNAL(Summary, "SOX", "SpO2.Max", "%", "0.00", "100.00", "0", "100",
                   0, 100, 1)
    EDF_STR_SIGNAL(Summary, "SAU", "SpO2Thresh", "min.", "0.00", "1440.00", "0", "1440",
                   0, 1440, 1)
    EDF_STR_SIGNAL(Summary, "VSR", "SpontTrig%", "%", "0.00", "100.00", "0", "200",
                   0, 200, 1)
    EDF_STR_SIGNAL(Summary, "VCR", "SpontCyc%", "%", "0.00", "100.00", "0", "200",
                   0, 200, 1)
    EDF_STR_SIGNAL(Summary, "MSP", "MaskPress.50", "cmH2O", "0.00", "40.00", "0", "2000",
                   0, 2000, 1)
    EDF_STR_SIGNAL(Summary, "PM9", "MaskPress.95", "cmH2O", "0.00", "40.00", "0", "2000",
                   0, 2000, 1)
    EDF_STR_SIGNAL(Summary, "PMA", "MaskPress.Max", "cmH2O", "0.00", "40.00", "0", "2000",
                   0, 2000, 1)
    EDF_STR_SIGNAL(Summary, "PIM", "TgtIPAP.50", "cmH2O", "0.00", "50.00", "0", "2500",
                   0, 2500, 1)
    EDF_STR_SIGNAL(Summary, "PI9", "TgtIPAP.95", "cmH2O", "0.00", "50.00", "0", "2500",
                   0, 2500, 1)
    EDF_STR_SIGNAL(Summary, "PIA", "TgtIPAP.Max", "cmH2O", "0.00", "50.00", "0", "2500",
                   0, 2500, 1)
    EDF_STR_SIGNAL(Summary, "PEM", "TgtEPAP.50", "cmH2O", "0.00", "30.00", "0", "1500",
                   0, 1500, 1)
    EDF_STR_SIGNAL(Summary, "PE9", "TgtEPAP.95", "cmH2O", "0.00", "30.00", "0", "1500",
                   0, 1500, 1)
    EDF_STR_SIGNAL(Summary, "PEA", "TgtEPAP.Max", "cmH2O", "0.00", "30.00", "0", "1500",
                   0, 1500, 1)
    EDF_STR_SIGNAL(Summary, "LKM", "Leak.50", "L/s", "0.00", "2.00", "0", "100",
                   0, 100, 1)
    EDF_STR_SIGNAL(Summary, "LK9", "Leak.95", "L/s", "0.00", "2.00", "0", "100",
                   0, 100, 1)
    EDF_STR_SIGNAL(Summary, "LK7", "Leak.70", "L/s", "0.00", "2.00", "0", "100",
                   0, 100, 1)
    EDF_STR_SIGNAL(Summary, "LMX", "Leak.Max", "L/s", "0.00", "2.00", "0", "100",
                   0, 100, 1)
    EDF_STR_SIGNAL(Summary, "VTM", "MinVent.50", "L/min", "0.00", "30.00", "0", "240",
                   0, 240, 1)
    EDF_STR_SIGNAL(Summary, "VT9", "MinVent.95", "L/min", "0.00", "30.00", "0", "240",
                   0, 240, 1)
    EDF_STR_SIGNAL(Summary, "VTA", "MinVent.Max", "L/min", "0.00", "30.00", "0", "240",
                   0, 240, 1)
    EDF_STR_SIGNAL(Summary, "RRM", "RespRate.50", "bpm", "0.00", "90.00", "0", "450",
                   0, 450, 1)
    EDF_STR_SIGNAL(Summary, "RR9", "RespRate.95", "bpm", "0.00", "90.00", "0", "450",
                   0, 450, 1)
    EDF_STR_SIGNAL(Summary, "RRA", "RespRate.Max", "bpm", "0.00", "90.00", "0", "450",
                   0, 450, 1)
    EDF_STR_SIGNAL(Summary, "TVM", "TidVol.50", "L", "0.00", "4.00", "0", "200",
                   0, 200, 1)
    EDF_STR_SIGNAL(Summary, "TV9", "TidVol.95", "L", "0.00", "4.00", "0", "200",
                   0, 200, 1)
    EDF_STR_SIGNAL(Summary, "TVA", "TidVol.Max", "L", "0.00", "4.00", "0", "200",
                   0, 200, 1)
    EDF_STR_SIGNAL(Summary, "VAM", "TgtVent.50", "L/min", "0.00", "30.00", "0", "240",
                   0, 240, 1)
    EDF_STR_SIGNAL(Summary, "VA9", "TgtVent.95", "L/min", "0.00", "30.00", "0", "240",
                   0, 240, 1)
    EDF_STR_SIGNAL(Summary, "VAA", "TgtVent.Max", "L/min", "0.00", "30.00", "0", "240",
                   0, 240, 1)
    EDF_STR_SIGNAL(Summary, "IEM", "IERatio.50", "%", "0.00", "400.00", "0", "400",
                   0, 400, 1)
    EDF_STR_SIGNAL(Summary, "IE9", "IERatio.95", "%", "0.00", "400.00", "0", "400",
                   0, 400, 1)
    EDF_STR_SIGNAL(Summary, "IEA", "IERatio.Max", "%", "0.00", "400.00", "0", "400",
                   0, 400, 1)
    EDF_STR_SIGNAL(Summary, "ISM", "Ti.50", "seconds", "0.00", "10.00", "0", "500",
                   0, 500, 1)
    EDF_STR_SIGNAL(Summary, "IS9", "Ti.95", "seconds", "0.00", "10.00", "0", "500",
                   0, 500, 1)
    EDF_STR_SIGNAL(Summary, "ISA", "Ti.Max", "seconds", "0.00", "10.00", "0", "500",
                   0, 500, 1)
    EDF_STR_SIGNAL(Summary, "AHI", "AHI", "", "0.00", "240.00", "0", "2400",
                   0, 2400, 1)
    EDF_STR_SIGNAL(Summary, "HSC", "HI", "", "0.00", "240.00", "0", "2400",
                   0, 2400, 1)
    EDF_STR_SIGNAL(Summary, "ASC", "AI", "", "0.00", "240.00", "0", "2400",
                   0, 2400, 1)
    EDF_STR_SIGNAL(Summary, "CSC", "OAI", "", "0.00", "240.00", "0", "2400",
                   0, 2400, 1)
    EDF_STR_SIGNAL(Summary, "OSC", "CAI", "", "0.00", "240.00", "0", "2400",
                   0, 2400, 1)
    EDF_STR_SIGNAL(Summary, "USC", "UAI", "", "0.00", "240.00", "0", "2400",
                   0, 2400, 1)
    EDF_STR_SIGNAL(Summary, "RCC", "RIN", "", "0.00", "240.00", "0", "2400",
                   0, 2400, 1)
    EDF_STR_SIGNAL(Summary, "CSD", "CSR", "", "0.00", "1440.00", "0", "1440",
                   0, 1440, 1)
    EDF_STR_SIGNAL(Custom, nullptr, "Crc16", "", "-32768.0", "32767.00", "-32768", "32767",
                   -32768, 32767, 1)
