
const char *const THERAPY_MODE_OPTIONS[] = {
    "CPAP", "AutoSet", "AutoSet For Her", "S", "ST", "T", "VAuto", "ASV", "ASVAuto", "iVAPS", "PAC",
};
const char *const THERAPY_MODE_WIRE_OPTIONS[] = {
    "CpapProfile", "AutoSetProfile", "AutoSetForHerProfile", "SpontProfile", "STProfile", "TimedProfile", "VAutoProfile", "ASVProfile", "ASVAutoProfile", "iVAPSProfile", "PACProfile",
};

const char *const SENSITIVITY_OPTIONS[] = {
    "Very Low", "Low", "Medium", "High", "Very High", "Very High 1", "Very High 2",
};
const char *const SENSITIVITY_WIRE_OPTIONS[] = {
    "VeryLow", "Low", "Medium", "High", "VeryHigh", "VeryHigh1", "VeryHigh2",
};

const char *const OFF_FIXED_OPTIONS[] = {
    "Off", "Fixed",
};

const char *const OFF_ON_OPTIONS[] = {
    "Off", "On",
};

const char *const MIN_ON_OPTIONS[] = {
    "Min", "On",
};

const char *const EPR_TYPE_OPTIONS[] = {
    "Ramp", "FullTime",
};

const char *const OFF_ON_AUTO_OPTIONS[] = {
    "Off", "On", "Auto",
};

const char *const MASK_TYPE_OPTIONS[] = {
    "Pillows", "FullFace", "Nasal", "Paediatric",
};

const char *const TUBE_TYPE_OPTIONS[] = {
    "15mm Non-Heated", "19mm Non-Heated", "3m Non-Heated",
};
const char *const TUBE_TYPE_WIRE_OPTIONS[] = {
    "15mmNonHeated", "19mmNonHeated", "3mNonHeated",
};

const char *const YES_NO_WIRE_ORDER_OPTIONS[] = {
    "Yes", "No",
};

const char *const AUTO_MANUAL_OPTIONS[] = {
    "Auto", "Manual",
};

const char *const NO_YES_WIRE_ORDER_OPTIONS[] = {
    "No", "Yes",
};

const char *const LANGUAGE_OPTIONS[] = {
    "English", "French", "German", "Italian", "Spanish EU", "Spanish US", "Portuguese EU", "Portuguese US", "Dutch", "Swedish", "Danish", "Norwegian", "Finnish", "Russian", "Turkish", "Polish", "Czech", "Greek", "Estonian", "Chinese Traditional", "Chinese Simplified", "Japanese", "Korean", "Croatian", "Hungarian", "Romanian", "Slovenian",
};
const char *const LANGUAGE_WIRE_OPTIONS[] = {
    "English", "French", "German", "Italian", "SpanishEU", "SpanishUS", "PortugueseEU", "PortugueseUS", "Dutch", "Swedish", "Danish", "Norwegian", "Finnish", "Russian", "Turkish", "Polish", "Czech", "Greek", "Estonian", "ChineseTraditional", "ChineseSimplified", "Japanese", "Korean", "Croatian", "Hungarian", "Romanian", "Slovenian",
};

const char *const NO_YES_NOT_ANSWERED_OPTIONS[] = {
    "No", "Yes", "NotAnswered",
};

const char *const TEMPERATURE_UNIT_OPTIONS[] = {
    "Celsius", "Fahrenheit",
};

const char *const PATIENT_VIEW_OPTIONS[] = {
    "Basic", "Full",
};

const char *const REMINDER_FREQUENCY_OPTIONS[] = {
    "Daily", "Weekly", "Fortnightly", "Off",
};

const char *const MONTH_PERIOD_OPTIONS[] = {
    "Off", "1 month", "2 months", "3 months", "4 months", "5 months", "6 months", "7 months", "8 months", "9 months", "10 months", "11 months", "12 months",
};
const char *const MONTH_PERIOD_WIRE_OPTIONS[] = {
    "P0M", "P1M", "P2M", "P3M", "P4M", "P5M", "P6M", "P7M", "P8M", "P9M", "P10M", "P11M", "P12M",
};

const char *const SPLASH_SCREEN_OPTIONS[] = {
    "Off", "ResMed",
};

const char *const STRING_PERCENTAGE_OPTIONS[] = {
    "String", "Percentage",
};

const As11SettingCompositeOption RAMP_TIME_COMPOSITE_OPTIONS[] = {
    {"Off", 0, nullptr},
    {"Auto", 2, nullptr},
    {"5", 1, "5"},
    {"10", 1, "10"},
    {"15", 1, "15"},
    {"20", 1, "20"},
    {"25", 1, "25"},
    {"30", 1, "30"},
    {"35", 1, "35"},
    {"40", 1, "40"},
    {"45", 1, "45"},
};

const As11SettingCompositeOption HUMIDITY_LEVEL_COMPOSITE_OPTIONS[] = {
    {"Off", 0, nullptr},
    {"1", 1, "1"},
    {"2", 1, "2"},
    {"3", 1, "3"},
    {"4", 1, "4"},
    {"5", 1, "5"},
    {"6", 1, "6"},
    {"7", 1, "7"},
    {"8", 1, "8"},
};

const As11SettingCompositeOption RISE_TIME_COMPOSITE_OPTIONS[] = {
    {"Min", 0, nullptr},
    {"150", 1, "150"},
    {"200", 1, "200"},
    {"250", 1, "250"},
    {"300", 1, "300"},
    {"350", 1, "350"},
    {"400", 1, "400"},
    {"450", 1, "450"},
    {"500", 1, "500"},
    {"550", 1, "550"},
    {"600", 1, "600"},
    {"650", 1, "650"},
    {"700", 1, "700"},
    {"750", 1, "750"},
    {"800", 1, "800"},
    {"850", 1, "850"},
    {"900", 1, "900"},
};

const As11SettingCompositeOption FALL_TIME_COMPOSITE_OPTIONS[] = {
    {"Min", 0, nullptr},
    {"100", 1, "100"},
    {"200", 1, "200"},
    {"300", 1, "300"},
    {"400", 1, "400"},
    {"500", 1, "500"},
    {"600", 1, "600"},
    {"700", 1, "700"},
};

const As11SettingDef SETTINGS[] = {
    {
        "MOP",
        As11SettingSource::Flat,
        As11ProfileId::None,
        nullptr,
        "TherapyMode",
        "Mode",
        "Therapy",
        "therapy",
        As11SettingKind::Enum,
        0.0f,
        10.0f,
        1.0f,
        THERAPY_MODE_OPTIONS,
        option_count(THERAPY_MODE_OPTIONS),
        0x07FFu,
        1,
        0,
        THERAPY_MODE_WIRE_OPTIONS
    },
    {
        "MPA",
        As11SettingSource::TherapyProfile,
        As11ProfileId::AutoSet,
        nullptr,
        "MaxPressure",
        "Max Pressure",
        "Therapy",
        "pressure",
        As11SettingKind::Number,
        4.0f,
        20.0f,
        0.2f,
        nullptr,
        0,
        0x0002u,
        50,
        1,
        nullptr
    },
    {
        "MPI",
        As11SettingSource::TherapyProfile,
        As11ProfileId::AutoSet,
        nullptr,
        "MinPressure",
        "Min Pressure",
        "Therapy",
        "pressure",
        As11SettingKind::Number,
        4.0f,
        20.0f,
        0.2f,
        nullptr,
        0,
        0x0002u,
        50,
        1,
        nullptr
    },
    {
        "STU",
        As11SettingSource::TherapyProfile,
        As11ProfileId::AutoSet,
        nullptr,
        "StartPressure",
        "Start Pressure",
        "Comfort",
        "therapy_start_pressure",
        As11SettingKind::Number,
        4.0f,
        20.0f,
        0.2f,
        nullptr,
        0,
        0x0002u,
        50,
        1,
        nullptr
    },
    {
        "HMA",
        As11SettingSource::TherapyProfile,
        As11ProfileId::HerAuto,
        nullptr,
        "MaxPressure",
        "Max Pressure",
        "Therapy",
        "pressure",
        As11SettingKind::Number,
        4.0f,
        20.0f,
        0.2f,
        nullptr,
        0,
        0x0004u,
        50,
        1,
        nullptr
    },
    {
        "HMI",
        As11SettingSource::TherapyProfile,
        As11ProfileId::HerAuto,
        nullptr,
        "MinPressure",
        "Min Pressure",
        "Therapy",
        "pressure",
        As11SettingKind::Number,
        4.0f,
        20.0f,
        0.2f,
        nullptr,
        0,
        0x0004u,
        50,
        1,
        nullptr
    },
    {
        "HSP",
        As11SettingSource::TherapyProfile,
        As11ProfileId::HerAuto,
        nullptr,
        "StartPressure",
        "Start Pressure",
        "Comfort",
        "therapy_start_pressure",
        As11SettingKind::Number,
        4.0f,
        20.0f,
        0.2f,
        nullptr,
        0,
        0x0004u,
        50,
        1,
        nullptr
    },
    {
        "IPC",
        As11SettingSource::TherapyProfile,
        As11ProfileId::Cpap,
        nullptr,
        "SetPressure",
        "Set Pressure",
        "Therapy",
        "pressure",
        As11SettingKind::Number,
        4.0f,
        20.0f,
        0.2f,
        nullptr,
        0,
        0x0001u,
        50,
        1,
        nullptr
    },
    {
        "STP",
        As11SettingSource::TherapyProfile,
        As11ProfileId::Cpap,
        nullptr,
        "StartPressure",
        "Start Pressure",
        "Comfort",
        "therapy_start_pressure",
        As11SettingKind::Number,
        4.0f,
        20.0f,
        0.2f,
        nullptr,
        0,
        0x0001u,
        50,
        1,
        nullptr
    },
    {
        "C11",
        As11SettingSource::TherapyProfile,
        As11ProfileId::Cpap,
        nullptr,
        "TriggerSensitivity",
        "Trigger",
        "Therapy",
        "trigger_cycle",
        As11SettingKind::Enum,
        0.0f,
        0.0f,
        1.0f,
        SENSITIVITY_OPTIONS,
        option_count(SENSITIVITY_OPTIONS),
        0x0001u,
        1,
        0,
        SENSITIVITY_WIRE_OPTIONS
    },
    {
        "ZZ1",
        As11SettingSource::TherapyProfile,
        As11ProfileId::Spont,
        nullptr,
        "TargetInspiratoryPressure",
        "IPAP",
        "Therapy",
        "pressure",
        As11SettingKind::Number,
        4.0f,
        25.0f,
        0.2f,
        nullptr,
        0,
        0x0008u,
        50,
        1,
        nullptr
    },
    {
        "ZZ2",
        As11SettingSource::TherapyProfile,
        As11ProfileId::Spont,
        nullptr,
        "TargetExpiratoryPressure",
        "EPAP",
        "Therapy",
        "pressure",
        As11SettingKind::Number,
        2.0f,
        25.0f,
        0.2f,
        nullptr,
        0,
        0x0008u,
        50,
        1,
        nullptr
    },
    {
        "ZZ3",
        As11SettingSource::TherapyProfile,
        As11ProfileId::Spont,
        nullptr,
        "StartPressure",
        "Start EPAP",
        "Comfort",
        "therapy_start_pressure",
        As11SettingKind::Number,
        2.0f,
        25.0f,
        0.2f,
        nullptr,
        0,
        0x0008u,
        50,
        1,
        nullptr
    },
    {
        "ZZ5",
        As11SettingSource::TherapyProfile,
        As11ProfileId::Spont,
        nullptr,
        "RespiratoryRateEnable",
        "Backup Rate",
        "Therapy",
        "backup_rate",
        As11SettingKind::Enum,
        0.0f,
        0.0f,
        1.0f,
        OFF_FIXED_OPTIONS,
        option_count(OFF_FIXED_OPTIONS),
        0x0008u,
        1,
        0,
        nullptr
    },
    {
        "ZZ8",
        As11SettingSource::TherapyProfile,
        As11ProfileId::Spont,
        nullptr,
        "SetMinInspiratoryTime",
        "Ti Min",
        "Therapy",
        "timing",
        As11SettingKind::Number,
        0.1f,
        4.0f,
        0.1f,
        nullptr,
        0,
        0x0008u,
        50,
        1,
        nullptr
    },
    {
        "ZZ7",
        As11SettingSource::TherapyProfile,
        As11ProfileId::Spont,
        nullptr,
        "SetMaxInspiratoryTime",
        "Ti Max",
        "Therapy",
        "timing",
        As11SettingKind::Number,
        0.3f,
        4.0f,
        0.1f,
        nullptr,
        0,
        0x0008u,
        50,
        1,
        nullptr
    },
    {
        "ZZ4",
        As11SettingSource::TherapyProfile,
        As11ProfileId::Spont,
        nullptr,
        "EasyBreatheEnable",
        "Easy-Breathe",
        "Therapy",
        "comfort",
        As11SettingKind::Enum,
        0.0f,
        0.0f,
        1.0f,
        OFF_ON_OPTIONS,
        option_count(OFF_ON_OPTIONS),
        0x0008u,
        1,
        0,
        nullptr
    },
    {
        "ZZ9",
        As11SettingSource::TherapyProfile,
        As11ProfileId::Spont,
        nullptr,
        "RiseTimeEnable",
        "Rise Time Mode",
        "Therapy",
        "timing",
        As11SettingKind::Enum,
        0.0f,
        0.0f,
        1.0f,
        MIN_ON_OPTIONS,
        option_count(MIN_ON_OPTIONS),
        0x0008u,
        1,
        0,
        nullptr
    },
    {
        "Z10",
        As11SettingSource::TherapyProfile,
        As11ProfileId::Spont,
        nullptr,
        "RiseTime",
        "Rise Time",
        "Therapy",
        "timing",
        As11SettingKind::Number,
        0.15f,
        0.9f,
        0.05f,
        nullptr,
        0,
        0x0008u,
        1000,
        2,
        nullptr
    },
    {
        "Z16",
        As11SettingSource::TherapyProfile,
        As11ProfileId::Spont,
        nullptr,
        "FallTimeEnable",
        "Fall Time Mode",
        "Therapy",
        "timing",
        As11SettingKind::Enum,
        0.0f,
        0.0f,
        1.0f,
        MIN_ON_OPTIONS,
        option_count(MIN_ON_OPTIONS),
        0x0008u,
        1,
        0,
        nullptr
    },
    {
        "Z17",
        As11SettingSource::TherapyProfile,
        As11ProfileId::Spont,
        nullptr,
        "FallTime",
        "Fall Time",
        "Therapy",
        "timing",
        As11SettingKind::Number,
        0.1f,
        0.7f,
        0.1f,
        nullptr,
        0,
        0x0008u,
        1000,
        1,
        nullptr
    },
    {
        "Z11",
        As11SettingSource::TherapyProfile,
        As11ProfileId::Spont,
        nullptr,
        "TriggerSensitivity",
        "Trigger",
        "Therapy",
        "trigger_cycle",
        As11SettingKind::Enum,
        0.0f,
        0.0f,
        1.0f,
        SENSITIVITY_OPTIONS,
        option_count(SENSITIVITY_OPTIONS),
        0x0008u,
        1,
        0,
        SENSITIVITY_WIRE_OPTIONS
    },
    {
        "Z12",
        As11SettingSource::TherapyProfile,
        As11ProfileId::Spont,
        nullptr,
        "CycleSensitivity",
        "Cycle",
        "Therapy",
        "trigger_cycle",
        As11SettingKind::Enum,
        0.0f,
        0.0f,
        1.0f,
        SENSITIVITY_OPTIONS,
        option_count(SENSITIVITY_OPTIONS),
        0x0008u,
        1,
        0,
        SENSITIVITY_WIRE_OPTIONS
    },
    {
        "XC1",
        As11SettingSource::TherapyProfile,
        As11ProfileId::ASV,
        nullptr,
        "TargetExpiratoryPressure",
        "EPAP",
        "Therapy",
        "pressure",
        As11SettingKind::Number,
        4.0f,
        15.0f,
        0.2f,
        nullptr,
        0,
        0x0080u,
        50,
        1,
        nullptr
    },
    {
        "XC3",
        As11SettingSource::TherapyProfile,
        As11ProfileId::ASV,
        nullptr,
        "MinPressureSupport",
        "Min PS",
        "Therapy",
        "pressure_support",
        As11SettingKind::Number,
        0.0f,
        6.0f,
        0.2f,
        nullptr,
        0,
        0x0080u,
        50,
        1,
        nullptr
    },
    {
        "XC2",
        As11SettingSource::TherapyProfile,
        As11ProfileId::ASV,
        nullptr,
        "MaxPressureSupport",
        "Max PS",
        "Therapy",
        "pressure_support",
        As11SettingKind::Number,
        5.0f,
        20.0f,
        0.2f,
        nullptr,
        0,
        0x0080u,
        50,
        1,
        nullptr
    },
    {
        "XC0",
        As11SettingSource::TherapyProfile,
        As11ProfileId::ASV,
        nullptr,
        "StartPressure",
        "Start EPAP",
        "Comfort",
        "therapy_start_pressure",
        As11SettingKind::Number,
        4.0f,
        15.0f,
        0.2f,
        nullptr,
        0,
        0x0080u,
        50,
        1,
        nullptr
    },
    {
        "XD2",
        As11SettingSource::TherapyProfile,
        As11ProfileId::ASVAuto,
        nullptr,
        "MinExpiratoryPressure",
        "Min EPAP",
        "Therapy",
        "pressure",
        As11SettingKind::Number,
        4.0f,
        15.0f,
        0.2f,
        nullptr,
        0,
        0x0100u,
        50,
        1,
        nullptr
    },
    {
        "XD1",
        As11SettingSource::TherapyProfile,
        As11ProfileId::ASVAuto,
        nullptr,
        "MaxExpiratoryPressure",
        "Max EPAP",
        "Therapy",
        "pressure",
        As11SettingKind::Number,
        4.0f,
        15.0f,
        0.2f,
        nullptr,
        0,
        0x0100u,
        50,
        1,
        nullptr
    },
    {
        "XD0",
        As11SettingSource::TherapyProfile,
        As11ProfileId::ASVAuto,
        nullptr,
        "StartPressure",
        "Start EPAP",
        "Comfort",
        "therapy_start_pressure",
        As11SettingKind::Number,
        4.0f,
        15.0f,
        0.2f,
        nullptr,
        0,
        0x0100u,
        50,
        1,
        nullptr
    },
    {
        "XD4",
        As11SettingSource::TherapyProfile,
        As11ProfileId::ASVAuto,
        nullptr,
        "MinPressureSupport",
        "Min PS",
        "Therapy",
        "pressure_support",
        As11SettingKind::Number,
        0.0f,
        6.0f,
        0.2f,
        nullptr,
        0,
        0x0100u,
        50,
        1,
        nullptr
    },
    {
        "XD3",
        As11SettingSource::TherapyProfile,
        As11ProfileId::ASVAuto,
        nullptr,
        "MaxPressureSupport",
        "Max PS",
        "Therapy",
        "pressure_support",
        As11SettingKind::Number,
        5.0f,
        20.0f,
        0.2f,
        nullptr,
        0,
        0x0100u,
        50,
        1,
        nullptr
    },
    {
        "XE1",
        As11SettingSource::TherapyProfile,
        As11ProfileId::VAuto,
        nullptr,
        "MaxInspiratoryPressure",
        "Max IPAP",
        "Therapy",
        "pressure",
        As11SettingKind::Number,
        4.0f,
        25.0f,
        0.2f,
        nullptr,
        0,
        0x0040u,
        50,
        1,
        nullptr
    },
    {
        "XE2",
        As11SettingSource::TherapyProfile,
        As11ProfileId::VAuto,
        nullptr,
        "MinExpiratoryPressure",
        "Min EPAP",
        "Therapy",
        "pressure",
        As11SettingKind::Number,
        4.0f,
        25.0f,
        0.2f,
        nullptr,
        0,
        0x0040u,
        50,
        1,
        nullptr
    },
    {
        "XE0",
        As11SettingSource::TherapyProfile,
        As11ProfileId::VAuto,
        nullptr,
        "StartPressure",
        "Start EPAP",
        "Comfort",
        "therapy_start_pressure",
        As11SettingKind::Number,
        4.0f,
        25.0f,
        0.2f,
        nullptr,
        0,
        0x0040u,
        50,
        1,
        nullptr
    },
    {
        "XE5",
        As11SettingSource::TherapyProfile,
        As11ProfileId::VAuto,
        nullptr,
        "SetMinInspiratoryTime",
        "Ti Min",
        "Therapy",
        "timing",
        As11SettingKind::Number,
        0.1f,
        4.0f,
        0.1f,
        nullptr,
        0,
        0x0040u,
        50,
        1,
        nullptr
    },
    {
        "XE4",
        As11SettingSource::TherapyProfile,
        As11ProfileId::VAuto,
        nullptr,
        "SetMaxInspiratoryTime",
        "Ti Max",
        "Therapy",
        "timing",
        As11SettingKind::Number,
        0.3f,
        4.0f,
        0.1f,
        nullptr,
        0,
        0x0040u,
        50,
        1,
        nullptr
    },
    {
        "XE3",
        As11SettingSource::TherapyProfile,
        As11ProfileId::VAuto,
        nullptr,
        "SetPressureSupport",
        "PS",
        "Therapy",
        "pressure_support",
        As11SettingKind::Number,
        0.0f,
        10.0f,
        0.2f,
        nullptr,
        0,
        0x0040u,
        50,
        1,
        nullptr
    },
    {
        "XE6",
        As11SettingSource::TherapyProfile,
        As11ProfileId::VAuto,
        nullptr,
        "TriggerSensitivity",
        "Trigger",
        "Therapy",
        "trigger_cycle",
        As11SettingKind::Enum,
        0.0f,
        0.0f,
        1.0f,
        SENSITIVITY_OPTIONS,
        option_count(SENSITIVITY_OPTIONS),
        0x0040u,
        1,
        0,
        SENSITIVITY_WIRE_OPTIONS
    },
    {
        "XE7",
        As11SettingSource::TherapyProfile,
        As11ProfileId::VAuto,
        nullptr,
        "CycleSensitivity",
        "Cycle",
        "Therapy",
        "trigger_cycle",
        As11SettingKind::Enum,
        0.0f,
        0.0f,
        1.0f,
        SENSITIVITY_OPTIONS,
        option_count(SENSITIVITY_OPTIONS),
        0x0040u,
        1,
        0,
        SENSITIVITY_WIRE_OPTIONS
    },
    {
        "XA1",
        As11SettingSource::TherapyProfile,
        As11ProfileId::ST,
        nullptr,
        "TargetInspiratoryPressure",
        "IPAP",
        "Therapy",
        "pressure",
        As11SettingKind::Number,
        4.0f,
        25.0f,
        0.2f,
        nullptr,
        0,
        0x0010u,
        50,
        1,
        nullptr
    },
    {
        "XA2",
        As11SettingSource::TherapyProfile,
        As11ProfileId::ST,
        nullptr,
        "TargetExpiratoryPressure",
        "EPAP",
        "Therapy",
        "pressure",
        As11SettingKind::Number,
        2.0f,
        25.0f,
        0.2f,
        nullptr,
        0,
        0x0010u,
        50,
        1,
        nullptr
    },
    {
        "XA3",
        As11SettingSource::TherapyProfile,
        As11ProfileId::ST,
        nullptr,
        "StartPressure",
        "Start EPAP",
        "Comfort",
        "therapy_start_pressure",
        As11SettingKind::Number,
        2.0f,
        25.0f,
        0.2f,
        nullptr,
        0,
        0x0010u,
        50,
        1,
        nullptr
    },
    {
        "XAC",
        As11SettingSource::TherapyProfile,
        As11ProfileId::ST,
        nullptr,
        "IntelligentBackupRateEnable",
        "iBR",
        "Therapy",
        "backup_rate",
        As11SettingKind::Enum,
        0.0f,
        0.0f,
        1.0f,
        OFF_ON_OPTIONS,
        option_count(OFF_ON_OPTIONS),
        0x0010u,
        1,
        0,
        nullptr
    },
    {
        "XAD",
        As11SettingSource::TherapyProfile,
        As11ProfileId::ST,
        nullptr,
        "TargetRespiratoryRate",
        "Target Pt Rate",
        "Therapy",
        "backup_rate",
        As11SettingKind::Number,
        0.0f,
        50.0f,
        1.0f,
        nullptr,
        0,
        0x0010u,
        5,
        0,
        nullptr
    },
    {
        "XA6",
        As11SettingSource::TherapyProfile,
        As11ProfileId::ST,
        nullptr,
        "SetRespiratoryRate",
        "Respiratory Rate",
        "Therapy",
        "backup_rate",
        As11SettingKind::Number,
        0.0f,
        50.0f,
        1.0f,
        nullptr,
        0,
        0x0010u,
        5,
        1,
        nullptr
    },
    {
        "XA8",
        As11SettingSource::TherapyProfile,
        As11ProfileId::ST,
        nullptr,
        "SetMinInspiratoryTime",
        "Ti Min",
        "Therapy",
        "timing",
        As11SettingKind::Number,
        0.1f,
        4.0f,
        0.1f,
        nullptr,
        0,
        0x0010u,
        50,
        1,
        nullptr
    },
    {
        "XA7",
        As11SettingSource::TherapyProfile,
        As11ProfileId::ST,
        nullptr,
        "SetMaxInspiratoryTime",
        "Ti Max",
        "Therapy",
        "timing",
        As11SettingKind::Number,
        0.3f,
        4.0f,
        0.1f,
        nullptr,
        0,
        0x0010u,
        50,
        1,
        nullptr
    },
    {
        "XA9",
        As11SettingSource::TherapyProfile,
        As11ProfileId::ST,
        nullptr,
        "RiseTimeEnable",
        "Rise Time Mode",
        "Therapy",
        "timing",
        As11SettingKind::Enum,
        0.0f,
        0.0f,
        1.0f,
        MIN_ON_OPTIONS,
        option_count(MIN_ON_OPTIONS),
        0x0010u,
        1,
        0,
        nullptr
    },
    {
        "XAA",
        As11SettingSource::TherapyProfile,
        As11ProfileId::ST,
        nullptr,
        "RiseTime",
        "Rise Time",
        "Therapy",
        "timing",
        As11SettingKind::Number,
        0.15f,
        0.9f,
        0.05f,
        nullptr,
        0,
        0x0010u,
        1000,
        2,
        nullptr
    },
    {
        "XAM",
        As11SettingSource::TherapyProfile,
        As11ProfileId::ST,
        nullptr,
        "FallTimeEnable",
        "Fall Time Mode",
        "Therapy",
        "timing",
        As11SettingKind::Enum,
        0.0f,
        0.0f,
        1.0f,
        MIN_ON_OPTIONS,
        option_count(MIN_ON_OPTIONS),
        0x0010u,
        1,
        0,
        nullptr
    },
    {
        "XAP",
        As11SettingSource::TherapyProfile,
        As11ProfileId::ST,
        nullptr,
        "FallTime",
        "Fall Time",
        "Therapy",
        "timing",
        As11SettingKind::Number,
        0.1f,
        0.7f,
        0.1f,
        nullptr,
        0,
        0x0010u,
        1000,
        1,
        nullptr
    },
    {
        "ZU1",
        As11SettingSource::TherapyProfile,
        As11ProfileId::ST,
        nullptr,
        "TriggerSensitivity",
        "Trigger",
        "Therapy",
        "trigger_cycle",
        As11SettingKind::Enum,
        0.0f,
        0.0f,
        1.0f,
        SENSITIVITY_OPTIONS,
        option_count(SENSITIVITY_OPTIONS),
        0x0010u,
        1,
        0,
        SENSITIVITY_WIRE_OPTIONS
    },
    {
        "XAB",
        As11SettingSource::TherapyProfile,
        As11ProfileId::ST,
        nullptr,
        "CycleSensitivity",
        "Cycle",
        "Therapy",
        "trigger_cycle",
        As11SettingKind::Enum,
        0.0f,
        0.0f,
        1.0f,
        SENSITIVITY_OPTIONS,
        option_count(SENSITIVITY_OPTIONS),
        0x0010u,
        1,
        0,
        SENSITIVITY_WIRE_OPTIONS
    },
    {
        "XB1",
        As11SettingSource::TherapyProfile,
        As11ProfileId::Timed,
        nullptr,
        "TargetInspiratoryPressure",
        "IPAP",
        "Therapy",
        "pressure",
        As11SettingKind::Number,
        4.0f,
        25.0f,
        0.2f,
        nullptr,
        0,
        0x0020u,
        50,
        1,
        nullptr
    },
    {
        "XB2",
        As11SettingSource::TherapyProfile,
        As11ProfileId::Timed,
        nullptr,
        "TargetExpiratoryPressure",
        "EPAP",
        "Therapy",
        "pressure",
        As11SettingKind::Number,
        2.0f,
        25.0f,
        0.2f,
        nullptr,
        0,
        0x0020u,
        50,
        1,
        nullptr
    },
    {
        "XB0",
        As11SettingSource::TherapyProfile,
        As11ProfileId::Timed,
        nullptr,
        "StartPressure",
        "Start EPAP",
        "Comfort",
        "therapy_start_pressure",
        As11SettingKind::Number,
        2.0f,
        25.0f,
        0.2f,
        nullptr,
        0,
        0x0020u,
        50,
        1,
        nullptr
    },
    {
        "XB4",
        As11SettingSource::TherapyProfile,
        As11ProfileId::Timed,
        nullptr,
        "SetRespiratoryRate",
        "Respiratory Rate",
        "Therapy",
        "backup_rate",
        As11SettingKind::Number,
        5.0f,
        50.0f,
        1.0f,
        nullptr,
        0,
        0x0020u,
        5,
        1,
        nullptr
    },
    {
        "XB5",
        As11SettingSource::TherapyProfile,
        As11ProfileId::Timed,
        nullptr,
        "SetInspiratoryTime",
        "Ti",
        "Therapy",
        "timing",
        As11SettingKind::Number,
        0.3f,
        4.0f,
        0.1f,
        nullptr,
        0,
        0x0020u,
        50,
        1,
        nullptr
    },
    {
        "XB6",
        As11SettingSource::TherapyProfile,
        As11ProfileId::Timed,
        nullptr,
        "RiseTimeEnable",
        "Rise Time Mode",
        "Therapy",
        "timing",
        As11SettingKind::Enum,
        0.0f,
        0.0f,
        1.0f,
        MIN_ON_OPTIONS,
        option_count(MIN_ON_OPTIONS),
        0x0020u,
        1,
        0,
        nullptr
    },
    {
        "XB7",
        As11SettingSource::TherapyProfile,
        As11ProfileId::Timed,
        nullptr,
        "RiseTime",
        "Rise Time",
        "Therapy",
        "timing",
        As11SettingKind::Number,
        0.15f,
        0.9f,
        0.05f,
        nullptr,
        0,
        0x0020u,
        1000,
        2,
        nullptr
    },
    {
        "AFC",
        As11SettingSource::FeatureProfile,
        As11ProfileId::None,
        "ComfortFeature",
        "AutoSetComfort",
        "AutoSet Response",
        "Comfort",
        "comfort",
        As11SettingKind::Enum,
        0.0f,
        0.0f,
        1.0f,
        OFF_ON_OPTIONS,
        option_count(OFF_ON_OPTIONS),
        0x0002u,
        1,
        0,
        nullptr
    },
    {
        "EPX",
        As11SettingSource::FeatureProfile,
        As11ProfileId::None,
        "EprFeature",
        "EprEnable",
        "EPR Enable",
        "Comfort",
        "comfort",
        As11SettingKind::Enum,
        0.0f,
        0.0f,
        1.0f,
        OFF_ON_OPTIONS,
        option_count(OFF_ON_OPTIONS),
        0x0007u,
        1,
        0,
        nullptr
    },
    {
        "EPT",
        As11SettingSource::FeatureProfile,
        As11ProfileId::None,
        "EprFeature",
        "EprType",
        "EPR Type",
        "Comfort",
        "comfort",
        As11SettingKind::Enum,
        0.0f,
        0.0f,
        1.0f,
        EPR_TYPE_OPTIONS,
        option_count(EPR_TYPE_OPTIONS),
        0x0007u,
        1,
        0,
        nullptr
    },
    {
        "EPR",
        As11SettingSource::FeatureProfile,
        As11ProfileId::None,
        "EprFeature",
        "EprPressure",
        "EPR Level",
        "Comfort",
        "comfort",
        As11SettingKind::Number,
        1.0f,
        3.0f,
        1.0f,
        nullptr,
        0,
        0x0007u,
        50,
        0,
        nullptr
    },
    {
        "RMT",
        As11SettingSource::FeatureProfile,
        As11ProfileId::None,
        "AutoRampFeature",
        "RampTime",
        "Ramp Time",
        "Comfort",
        "ramp",
        As11SettingKind::Number,
        5.0f,
        45.0f,
        5.0f,
        nullptr,
        0,
        0x07FFu,
        1,
        0,
        nullptr
    },
    {
        "RMA",
        As11SettingSource::FeatureProfile,
        As11ProfileId::None,
        "AutoRampFeature",
        "RampEnable",
        "Ramp Mode",
        "Comfort",
        "ramp",
        As11SettingKind::Enum,
        0.0f,
        0.0f,
        1.0f,
        OFF_ON_AUTO_OPTIONS,
        option_count(OFF_ON_AUTO_OPTIONS),
        0x07FFu,
        1,
        0,
        nullptr
    },
    {
        "SST",
        As11SettingSource::FeatureProfile,
        As11ProfileId::None,
        "SmartStartStopFeature",
        "SmartStart",
        "SmartStart",
        "Preferences",
        "therapy_behavior",
        As11SettingKind::Enum,
        0.0f,
        0.0f,
        1.0f,
        OFF_ON_OPTIONS,
        option_count(OFF_ON_OPTIONS),
        0x07FFu,
        1,
        0,
        nullptr
    },
    {
        "SSP",
        As11SettingSource::FeatureProfile,
        As11ProfileId::None,
        "SmartStartStopFeature",
        "SmartStop",
        "SmartStop",
        "Preferences",
        "therapy_behavior",
        As11SettingKind::Enum,
        0.0f,
        0.0f,
        1.0f,
        OFF_ON_OPTIONS,
        option_count(OFF_ON_OPTIONS),
        0x07FFu,
        1,
        0,
        nullptr
    },
    {
        "MSK",
        As11SettingSource::FeatureProfile,
        As11ProfileId::None,
        "CircuitFeature",
        "MaskType",
        "Mask Setting",
        "Circuit",
        "circuit",
        As11SettingKind::Enum,
        0.0f,
        0.0f,
        1.0f,
        MASK_TYPE_OPTIONS,
        option_count(MASK_TYPE_OPTIONS),
        0x07FFu,
        1,
        0,
        nullptr
    },
    {
        "TBT",
        As11SettingSource::FeatureProfile,
        As11ProfileId::None,
        "CircuitFeature",
        "TubeType",
        "Tube",
        "Circuit",
        "circuit",
        As11SettingKind::Enum,
        0.0f,
        0.0f,
        1.0f,
        TUBE_TYPE_OPTIONS,
        option_count(TUBE_TYPE_OPTIONS),
        0x07FFu,
        1,
        0,
        TUBE_TYPE_WIRE_OPTIONS
    },
    {
        "ABF",
        As11SettingSource::FeatureProfile,
        As11ProfileId::None,
        "CircuitFeature",
        "AntiBacterialFilter",
        "B/V Filter",
        "Circuit",
        "circuit",
        As11SettingKind::Enum,
        0.0f,
        0.0f,
        1.0f,
        YES_NO_WIRE_ORDER_OPTIONS,
        option_count(YES_NO_WIRE_ORDER_OPTIONS),
        0x07FFu,
        1,
        0,
        nullptr
    },
    {
        "CCO",
        As11SettingSource::FeatureProfile,
        As11ProfileId::None,
        "ClimateFeature",
        "ClimateControl",
        "Climate Control",
        "Comfort",
        "climate",
        As11SettingKind::Enum,
        0.0f,
        0.0f,
        1.0f,
        AUTO_MANUAL_OPTIONS,
        option_count(AUTO_MANUAL_OPTIONS),
        0x07FFu,
        1,
        0,
        nullptr
    },
    {
        "HMX",
        As11SettingSource::FeatureProfile,
        As11ProfileId::None,
        "ClimateFeature",
        "HumidifierSettingEnable",
        "Humidity Mode",
        "Comfort",
        "climate",
        As11SettingKind::Enum,
        0.0f,
        0.0f,
        1.0f,
        OFF_ON_OPTIONS,
        option_count(OFF_ON_OPTIONS),
        0x07FFu,
        1,
        0,
        nullptr
    },
    {
        "HMS",
        As11SettingSource::FeatureProfile,
        As11ProfileId::None,
        "ClimateFeature",
        "HumidifierLevel",
        "Humidity Level",
        "Comfort",
        "climate",
        As11SettingKind::Number,
        1.0f,
        8.0f,
        1.0f,
        nullptr,
        0,
        0x07FFu,
        1,
        0,
        nullptr
    },
    {
        "HTX",
        As11SettingSource::FeatureProfile,
        As11ProfileId::None,
        "ClimateFeature",
        "HeatedTubeSettingEnable",
        "Tube Heating",
        "Comfort",
        "climate",
        As11SettingKind::Enum,
        0.0f,
        0.0f,
        1.0f,
        OFF_ON_AUTO_OPTIONS,
        option_count(OFF_ON_AUTO_OPTIONS),
        0x07FFu,
        1,
        0,
        nullptr
    },
    {
        "HTS",
        As11SettingSource::FeatureProfile,
        As11ProfileId::None,
        "ClimateFeature",
        "HeatedTubeTemperature",
        "Tube Temp.",
        "Comfort",
        "climate",
        As11SettingKind::Number,
        15.6f,
        30.0f,
        0.1f,
        nullptr,
        0,
        0x07FFu,
        10,
        1,
        nullptr
    },
    {
        "EXH",
        As11SettingSource::FeatureProfile,
        As11ProfileId::None,
        "ClimateFeature",
        "ExternalHumidifier",
        "External Humidifier",
        "Comfort",
        "climate",
        As11SettingKind::Enum,
        0.0f,
        0.0f,
        1.0f,
        NO_YES_WIRE_ORDER_OPTIONS,
        option_count(NO_YES_WIRE_ORDER_OPTIONS),
        MODES_NONE,
        1,
        0,
        nullptr
    },
    {
        "LNC",
        As11SettingSource::FeatureProfile,
        As11ProfileId::None,
        "LanguageFeature",
        "LanguageConfiguration",
        "Language Configuration",
        "Preferences",
        "locale",
        As11SettingKind::Number,
        0.0f,
        134217727.0f,
        1.0f,
        nullptr,
        0,
        MODES_NONE,
        1,
        0,
        nullptr
    },
    {
        "LAN",
        As11SettingSource::FeatureProfile,
        As11ProfileId::None,
        "LanguageFeature",
        "Language",
        "Language",
        "Preferences",
        "locale",
        As11SettingKind::Enum,
        0.0f,
        0.0f,
        1.0f,
        LANGUAGE_OPTIONS,
        option_count(LANGUAGE_OPTIONS),
        0x07FFu,
        1,
        0,
        LANGUAGE_WIRE_OPTIONS
    },
    {
        "SLS",
        As11SettingSource::FeatureProfile,
        As11ProfileId::None,
        "LanguageFeature",
        "LanguageSelection",
        "Language Selection",
        "Preferences",
        "locale",
        As11SettingKind::Enum,
        0.0f,
        0.0f,
        1.0f,
        OFF_ON_OPTIONS,
        option_count(OFF_ON_OPTIONS),
        MODES_NONE,
        1,
        0,
        nullptr
    },
    {
        "SCP",
        As11SettingSource::FeatureProfile,
        As11ProfileId::None,
        "UserSolutionFeature",
        "SurveyPersonalise",
        "Survey Personalise",
        "Device",
        "survey",
        As11SettingKind::Enum,
        0.0f,
        0.0f,
        1.0f,
        NO_YES_NOT_ANSWERED_OPTIONS,
        option_count(NO_YES_NOT_ANSWERED_OPTIONS),
        MODES_NONE,
        1,
        0,
        nullptr
    },
    {
        "TMU",
        As11SettingSource::FeatureProfile,
        As11ProfileId::None,
        "TemperatureFeature",
        "TemperatureUnit",
        "Temp. Units",
        "Preferences",
        "locale",
        As11SettingKind::Enum,
        0.0f,
        0.0f,
        1.0f,
        TEMPERATURE_UNIT_OPTIONS,
        option_count(TEMPERATURE_UNIT_OPTIONS),
        0x07FFu,
        1,
        0,
        nullptr
    },
    {
        "ACC",
        As11SettingSource::FeatureProfile,
        As11ProfileId::None,
        "PatientViewFeature",
        "PatientView",
        "Patient View",
        "Preferences",
        "patient_access",
        As11SettingKind::Enum,
        0.0f,
        0.0f,
        1.0f,
        PATIENT_VIEW_OPTIONS,
        option_count(PATIENT_VIEW_OPTIONS),
        0x07FFu,
        1,
        0,
        nullptr
    },
    {
        "EPA",
        As11SettingSource::FeatureProfile,
        As11ProfileId::None,
        "EprFeature",
        "EprEnablePatientAccess",
        "EPR Patient Access",
        "Preferences",
        "patient_access",
        As11SettingKind::Enum,
        0.0f,
        0.0f,
        1.0f,
        OFF_ON_OPTIONS,
        option_count(OFF_ON_OPTIONS),
        0x07FFu,
        1,
        0,
        nullptr
    },
    {
        "RPE",
        As11SettingSource::FeatureProfile,
        As11ProfileId::None,
        "AutoRampFeature",
        "RampEnablePatientAccess",
        "Ramp Patient Access",
        "Preferences",
        "patient_access",
        As11SettingKind::Enum,
        0.0f,
        0.0f,
        1.0f,
        OFF_ON_OPTIONS,
        option_count(OFF_ON_OPTIONS),
        0x07FFu,
        1,
        0,
        nullptr
    },
    {
        "DAH",
        As11SettingSource::FeatureProfile,
        As11ProfileId::None,
        "PatientViewFeature",
        "DisplayAHI",
        "Display AHI",
        "Preferences",
        "patient_access",
        As11SettingKind::Enum,
        0.0f,
        0.0f,
        1.0f,
        NO_YES_WIRE_ORDER_OPTIONS,
        option_count(NO_YES_WIRE_ORDER_OPTIONS),
        0x07FFu,
        1,
        0,
        nullptr
    },
    {
        "TZO",
        As11SettingSource::FeatureProfile,
        As11ProfileId::None,
        "TimeZoneFeature",
        "TimeZoneOffset",
        "Time Zone Offset",
        "Preferences",
        "locale_time",
        As11SettingKind::Number,
        -720.0f,
        840.0f,
        60.0f,
        nullptr,
        0,
        MODES_NONE,
        1,
        0,
        nullptr
    },
    {
        "MAI",
        As11SettingSource::FeatureProfile,
        As11ProfileId::None,
        "CareCheckFeature",
        "CareCheckToggle",
        "Care Check",
        "Device",
        "device_check",
        As11SettingKind::Enum,
        0.0f,
        0.0f,
        1.0f,
        OFF_ON_OPTIONS,
        option_count(OFF_ON_OPTIONS),
        MODES_NONE,
        1,
        0,
        nullptr
    },
    {
        "SCO",
        As11SettingSource::FeatureProfile,
        As11ProfileId::None,
        "DeviceHealthFeature",
        "SoundcheckFeatureToggle",
        "Soundcheck",
        "Device",
        "device_health",
        As11SettingKind::Enum,
        0.0f,
        0.0f,
        1.0f,
        OFF_ON_OPTIONS,
        option_count(OFF_ON_OPTIONS),
        MODES_NONE,
        1,
        0,
        nullptr
    },
    {
        "SCK",
        As11SettingSource::FeatureProfile,
        As11ProfileId::None,
        "DeviceHealthFeature",
        "SoundcheckRunFrequency",
        "Device Diagnostic",
        "Device",
        "device_health",
        As11SettingKind::Enum,
        0.0f,
        0.0f,
        1.0f,
        REMINDER_FREQUENCY_OPTIONS,
        option_count(REMINDER_FREQUENCY_OPTIONS),
        MODES_NONE,
        1,
        0,
        nullptr
    },
    {
        "RIM",
        As11SettingSource::FeatureProfile,
        As11ProfileId::None,
        "ReminderFeature.ReminderMask",
        "Enable",
        "Enable",
        "Reminders",
        "reminder",
        As11SettingKind::Enum,
        0.0f,
        0.0f,
        1.0f,
        OFF_ON_OPTIONS,
        option_count(OFF_ON_OPTIONS),
        MODES_NONE,
        1,
        0,
        nullptr
    },
    {
        "RTM",
        As11SettingSource::FeatureProfile,
        As11ProfileId::None,
        "ReminderFeature.ReminderMask",
        "StartDateTime",
        "Start Date",
        "Reminders",
        "reminder",
        As11SettingKind::Number,
        0.0f,
        2147483647.0f,
        1.0f,
        nullptr,
        0,
        MODES_NONE,
        1,
        0,
        nullptr
    },
    {
        "RDM",
        As11SettingSource::FeatureProfile,
        As11ProfileId::None,
        "ReminderFeature.ReminderMask",
        "Period",
        "Period",
        "Reminders",
        "reminder",
        As11SettingKind::Enum,
        0.0f,
        0.0f,
        1.0f,
        MONTH_PERIOD_OPTIONS,
        option_count(MONTH_PERIOD_OPTIONS),
        MODES_NONE,
        1,
        0,
        MONTH_PERIOD_WIRE_OPTIONS
    },
    {
        "RIT",
        As11SettingSource::FeatureProfile,
        As11ProfileId::None,
        "ReminderFeature.ReminderTubing",
        "Enable",
        "Enable",
        "Reminders",
        "reminder",
        As11SettingKind::Enum,
        0.0f,
        0.0f,
        1.0f,
        OFF_ON_OPTIONS,
        option_count(OFF_ON_OPTIONS),
        MODES_NONE,
        1,
        0,
        nullptr
    },
    {
        "RTT",
        As11SettingSource::FeatureProfile,
        As11ProfileId::None,
        "ReminderFeature.ReminderTubing",
        "StartDateTime",
        "Start Date",
        "Reminders",
        "reminder",
        As11SettingKind::Number,
        0.0f,
        2147483647.0f,
        1.0f,
        nullptr,
        0,
        MODES_NONE,
        1,
        0,
        nullptr
    },
    {
        "RDT",
        As11SettingSource::FeatureProfile,
        As11ProfileId::None,
        "ReminderFeature.ReminderTubing",
        "Period",
        "Period",
        "Reminders",
        "reminder",
        As11SettingKind::Enum,
        0.0f,
        0.0f,
        1.0f,
        MONTH_PERIOD_OPTIONS,
        option_count(MONTH_PERIOD_OPTIONS),
        MODES_NONE,
        1,
        0,
        MONTH_PERIOD_WIRE_OPTIONS
    },
    {
        "RIF",
        As11SettingSource::FeatureProfile,
        As11ProfileId::None,
        "ReminderFeature.ReminderFilter",
        "Enable",
        "Enable",
        "Reminders",
        "reminder",
        As11SettingKind::Enum,
        0.0f,
        0.0f,
        1.0f,
        OFF_ON_OPTIONS,
        option_count(OFF_ON_OPTIONS),
        MODES_NONE,
        1,
        0,
        nullptr
    },
    {
        "RTF",
        As11SettingSource::FeatureProfile,
        As11ProfileId::None,
        "ReminderFeature.ReminderFilter",
        "StartDateTime",
        "Start Date",
        "Reminders",
        "reminder",
        As11SettingKind::Number,
        0.0f,
        2147483647.0f,
        1.0f,
        nullptr,
        0,
        MODES_NONE,
        1,
        0,
        nullptr
    },
    {
        "RDF",
        As11SettingSource::FeatureProfile,
        As11ProfileId::None,
        "ReminderFeature.ReminderFilter",
        "Period",
        "Period",
        "Reminders",
        "reminder",
        As11SettingKind::Enum,
        0.0f,
        0.0f,
        1.0f,
        MONTH_PERIOD_OPTIONS,
        option_count(MONTH_PERIOD_OPTIONS),
        MODES_NONE,
        1,
        0,
        MONTH_PERIOD_WIRE_OPTIONS
    },
    {
        "RIC",
        As11SettingSource::FeatureProfile,
        As11ProfileId::None,
        "ReminderFeature.ReminderHumidifier",
        "Enable",
        "Enable",
        "Reminders",
        "reminder",
        As11SettingKind::Enum,
        0.0f,
        0.0f,
        1.0f,
        OFF_ON_OPTIONS,
        option_count(OFF_ON_OPTIONS),
        MODES_NONE,
        1,
        0,
        nullptr
    },
    {
        "RTH",
        As11SettingSource::FeatureProfile,
        As11ProfileId::None,
        "ReminderFeature.ReminderHumidifier",
        "StartDateTime",
        "Start Date",
        "Reminders",
        "reminder",
        As11SettingKind::Number,
        0.0f,
        2147483647.0f,
        1.0f,
        nullptr,
        0,
        MODES_NONE,
        1,
        0,
        nullptr
    },
    {
        "RDH",
        As11SettingSource::FeatureProfile,
        As11ProfileId::None,
        "ReminderFeature.ReminderHumidifier",
        "Period",
        "Period",
        "Reminders",
        "reminder",
        As11SettingKind::Enum,
        0.0f,
        0.0f,
        1.0f,
        MONTH_PERIOD_OPTIONS,
        option_count(MONTH_PERIOD_OPTIONS),
        MODES_NONE,
        1,
        0,
        MONTH_PERIOD_WIRE_OPTIONS
    },
    {
        "TUD",
        As11SettingSource::FeatureProfile,
        As11ProfileId::None,
        "DisplayFeature",
        "TotalUsedHoursDisplayToggle",
        "Total Used Hours",
        "Preferences",
        "display",
        As11SettingKind::Enum,
        0.0f,
        0.0f,
        1.0f,
        OFF_ON_OPTIONS,
        option_count(OFF_ON_OPTIONS),
        MODES_NONE,
        1,
        0,
        nullptr
    },
    {
        "SSE",
        As11SettingSource::FeatureProfile,
        As11ProfileId::None,
        "DisplayFeature",
        "SplashScreenDisplaySelection",
        "Splash Screen",
        "Preferences",
        "display",
        As11SettingKind::Enum,
        0.0f,
        0.0f,
        1.0f,
        SPLASH_SCREEN_OPTIONS,
        option_count(SPLASH_SCREEN_OPTIONS),
        MODES_NONE,
        1,
        0,
        nullptr
    },
    {
        "SSY",
        As11SettingSource::FeatureProfile,
        As11ProfileId::None,
        "DisplayFeature",
        "CycleDisplayFormat",
        "Cycle Display Format",
        "Preferences",
        "display",
        As11SettingKind::Enum,
        0.0f,
        0.0f,
        1.0f,
        STRING_PERCENTAGE_OPTIONS,
        option_count(STRING_PERCENTAGE_OPTIONS),
        MODES_NONE,
        1,
        0,
        nullptr
    },
    {
        "CCA",
        As11SettingSource::FeatureProfile,
        As11ProfileId::None,
        "DisplayFeature",
        "CareCheckInAvailable",
        "Care Check-In",
        "Device",
        "device_check",
        As11SettingKind::Enum,
        0.0f,
        0.0f,
        1.0f,
        OFF_ON_OPTIONS,
        option_count(OFF_ON_OPTIONS),
        MODES_NONE,
        1,
        0,
        nullptr
    },
    {
        "MAS",
        As11SettingSource::FeatureProfile,
        As11ProfileId::None,
        "DisplayFeature",
        "MyAirScreens",
        "myAir",
        "Preferences",
        "display",
        As11SettingKind::Enum,
        0.0f,
        0.0f,
        1.0f,
        OFF_ON_OPTIONS,
        option_count(OFF_ON_OPTIONS),
        MODES_NONE,
        1,
        0,
        nullptr
    },
    {
        "CFC",
        As11SettingSource::FeatureProfile,
        As11ProfileId::None,
        "DisplayFeature",
        "ClinicalConfirmation",
        "Confirm Clinical Menu",
        "Preferences",
        "patient_access",
        As11SettingKind::Enum,
        0.0f,
        0.0f,
        1.0f,
        OFF_ON_OPTIONS,
        option_count(OFF_ON_OPTIONS),
        MODES_NONE,
        1,
        0,
        nullptr
    },
    {
        "BBE",
        As11SettingSource::FeatureProfile,
        As11ProfileId::None,
        "DisplayFeature",
        "DynamicMessageToggle",
        "Notifications",
        "Preferences",
        "display",
        As11SettingKind::Enum,
        0.0f,
        0.0f,
        1.0f,
        OFF_ON_OPTIONS,
        option_count(OFF_ON_OPTIONS),
        MODES_NONE,
        1,
        0,
        nullptr
    },
    {
        "SCF",
        As11SettingSource::FeatureProfile,
        As11ProfileId::None,
        "ConfirmStopFeature",
        "ConfirmStopEnable",
        "Confirm Stop",
        "Preferences",
        "therapy_behavior",
        As11SettingKind::Enum,
        0.0f,
        0.0f,
        1.0f,
        OFF_ON_OPTIONS,
        option_count(OFF_ON_OPTIONS),
        0x07FFu,
        1,
        0,
        nullptr
    },
    {
        "TLF",
        As11SettingSource::FeatureProfile,
        As11ProfileId::None,
        "TherapyLEDFeature",
        "TherapyLEDAlwaysOn",
        "Therapy LED",
        "Preferences",
        "therapy_behavior",
        As11SettingKind::Enum,
        0.0f,
        0.0f,
        1.0f,
        OFF_ON_OPTIONS,
        option_count(OFF_ON_OPTIONS),
        0x07FFu,
        1,
        0,
        nullptr
    },
    {
        "MKD",
        As11SettingSource::FeatureProfile,
        As11ProfileId::None,
        "MaskSenseFeature",
        "MaskSenseToggle",
        "AcousticSignal",
        "Device",
        "mask_sense",
        As11SettingKind::Enum,
        0.0f,
        0.0f,
        1.0f,
        OFF_ON_OPTIONS,
        option_count(OFF_ON_OPTIONS),
        MODES_NONE,
        1,
        0,
        nullptr
    }
};

const As11SettingCompositeDef SETTING_COMPOSITES[] = {
    {
        "RMA+RMT",
        "Ramp Time",
        "RMA",
        "RMT",
        1,
        "Comfort",
        "ramp",
        RAMP_TIME_COMPOSITE_OPTIONS,
        option_count(RAMP_TIME_COMPOSITE_OPTIONS)
    },
    {
        "HMX+HMS",
        "Humidity Level",
        "HMX",
        "HMS",
        1,
        "Comfort",
        "climate",
        HUMIDITY_LEVEL_COMPOSITE_OPTIONS,
        option_count(HUMIDITY_LEVEL_COMPOSITE_OPTIONS)
    },
    {
        "ZZ9+Z10",
        "Rise Time",
        "ZZ9",
        "Z10",
        1,
        "Therapy",
        "timing",
        RISE_TIME_COMPOSITE_OPTIONS,
        option_count(RISE_TIME_COMPOSITE_OPTIONS)
    },
    {
        "Z16+Z17",
        "Fall Time",
        "Z16",
        "Z17",
        1,
        "Therapy",
        "timing",
        FALL_TIME_COMPOSITE_OPTIONS,
        option_count(FALL_TIME_COMPOSITE_OPTIONS)
    },
    {
        "XA9+XAA",
        "Rise Time",
        "XA9",
        "XAA",
        1,
        "Therapy",
        "timing",
        RISE_TIME_COMPOSITE_OPTIONS,
        option_count(RISE_TIME_COMPOSITE_OPTIONS)
    },
    {
        "XAM+XAP",
        "Fall Time",
        "XAM",
        "XAP",
        1,
        "Therapy",
        "timing",
        FALL_TIME_COMPOSITE_OPTIONS,
        option_count(FALL_TIME_COMPOSITE_OPTIONS)
    },
    {
        "XB6+XB7",
        "Rise Time",
        "XB6",
        "XB7",
        1,
        "Therapy",
        "timing",
        RISE_TIME_COMPOSITE_OPTIONS,
        option_count(RISE_TIME_COMPOSITE_OPTIONS)
    },
};
